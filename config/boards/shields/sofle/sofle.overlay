/ {
    /* WS2812/Neopixel underglow chain for Sofle */
    zmk_underglow: zmk_underglow {
        compatible = "zmk,underglow";
        label = "Underglow";

        chain-length = <24>;            /* 🔧 total LEDs on your Sofle (guess 24–30 if unsure) */
        color-order = "GRB";            /* WS2812 uses GRB */

        /* 🔧 LED data pin: try P0.06 first; if no lights, try P0.08 */
        gpios = <&gpio0 6 GPIO_ACTIVE_HIGH>;  /* P0.06 */
    };
};