## config/west.yml
```yaml
manifest:
  remotes:
    - name: zmkfirmware
      url-base: https://github.com

  projects:
    - name: zmk
      remote: zmkfirmware
      revision: main
      import: app/west.yml   # <-- pulls in Zephyr + extensions

  self:
    path: config
```

## modules/caps_oled/Kconfig
```kconfig
menu "Caps OLED"

config ZMK_WIDGET_CAPS_STATUS
    bool "Enable Caps status OLED widget"
    default y
    depends on ZMK_DISPLAY

endmenu
```
